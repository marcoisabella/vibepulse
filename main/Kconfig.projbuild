## main/Kconfig.projbuild
```kconfig
menu "Torget development diagnostics"
config TORGET_BOOT_HEALTH_FORCE_FAIL
    bool "Force pending OTA image to fail its health gate"
    default n
    help
        Development-only failure injection for the physical rollback test.
endmenu

menu "VibePulse optional network features"
config TK_VIBEPULSE_INTERACTION_RELAY
    bool "Encrypted Needs You relay (works across unrelated Wi-Fi)"
    default n
    select MBEDTLS_HKDF_C
    help
        Poll a separately deployed Cloudflare mailbox for end-to-end
        encrypted Claude/Codex Needs You views and return signed encrypted
        verdicts. This is independent of the numbers relay and remains off
        in a fresh clone. Enabling it requires the four matching macros in
        secrets.h; the build fails with recovery instructions if incomplete.
config TK_VIBEPULSE_AGENT_STATUS_RELAY
    bool "Encrypted live Claude/Codex status relay"
    default n
    select MBEDTLS_HKDF_C
    help
        Poll the same user-owned Cloudflare mailbox for a minimized,
        fixed-size, end-to-end encrypted live agent snapshot when direct LAN
        status has been unavailable for five seconds. Direct LAN always wins.
        This switch is independent and remains off in a fresh clone.
endmenu

menu "VibePulse panel behaviour"
config TK_PAGE_AUTO_ADVANCE
        bool "Turn the pages automatically"
        default y
        help
          The panel advances through its views on its own, so a shelf screen
          shows everything it knows instead of whichever page was last swiped
          to. Also spreads the image across the AMOLED rather than holding one
          frame for hours. A finger always wins: touching the glass holds the
          page, and rotation resumes only after the panel has been left alone.
          Nothing rotates while a NEEDS YOU takeover is on screen.

config TK_PAGE_AUTO_ADVANCE_S
        int "Seconds each page holds"
        depends on TK_PAGE_AUTO_ADVANCE
        range 3 120
        default 10
        help
          Ten seconds is the calm end of signage practice: long enough to notice
          the change and read the page from across the room, short enough that a
          full cycle stays under a couple of minutes. Below about five it starts
          to read as busy in peripheral vision, which is the opposite of what an
          ambient display is for.

config TK_PAGE_RESUME_AFTER_S
        int "Seconds of stillness before rotation resumes"
        depends on TK_PAGE_AUTO_ADVANCE
        range 5 600
        default 45
        help
          How long the panel waits after the last touch before turning pages
          again. This is the guard against the classic carousel failure: the
          screen moving on while someone is still reading the page they
          deliberately swiped to.
endmenu
```
